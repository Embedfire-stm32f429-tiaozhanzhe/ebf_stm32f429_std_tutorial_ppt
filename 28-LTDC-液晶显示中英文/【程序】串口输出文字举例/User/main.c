/**
  ******************************************************************************
  * @file    main.c
  * @author  fire
  * @version V1.0
  * @date    2015-xx-xx
  * @brief   串口接发测试，串口接收到数据后马上回传。
  ******************************************************************************
  * @attention
  *
  * 实验平台:秉火  STM32 F429 开发板
  * 论坛    :http://www.chuxue123.com
  * 淘宝    :http://firestm32.taobao.com
  *
  ******************************************************************************
  */
  
#include "stm32f4xx.h"
#include "./usart/bsp_debug_usart.h"

//作业：
//设置字模为64*64大小，并改写程序，使输出正常的汉字


/* 当(0)字模数据
*/

uint8_t charater[] =



{0x00,0x00,0x00,0x00,0x00,0x00,0x00,0x18,0x00,0x00,0x18,0x00,0x0C,0x18,0x70,0x06,0x18,0x60,0x03,0x18,0x80,0x01,0x19,0x00,
0x00,0x1A,0x00,0x00,0x18,0x08,0x1F,0xFF,0xFC,0x00,0x00,0x18,0x00,0x00,0x18,0x00,0x00,0x18,0x00,0x00,0x18,0x0F,0xFF,0xF8,
0x00,0x00,0x18,0x00,0x00,0x18,0x00,0x00,0x18,0x00,0x00,0x18,0x00,0x00,0x18,0x1F,0xFF,0xF8,0x00,0x00,0x18,0x00,0x00,0x00};/*"当",0*/



void dis_charater(void)
{
  uint8_t i,j ;
  
  for(i=0;i<24;i++)  //扫描N行
  {
    //扫描一行内的第一个字节数据
    for(j=0;j<8;j++)  //扫描各个像素点
    {
      if(((charater[3*i] << j )&0x80) ) //如果运算结果为非0值，表示像素点有笔迹，为0表示空白
        printf("*");    //笔迹像素点，输出*号
      else  
        printf(" ");    //空白像素点，输出空格
    }
  
    //扫描一行内的第二个字节数据
    for(j=0;j<8;j++)  //扫描各个像素点
    {
      if(((charater[3*i+1] << j )&0x80) ) //如果运算结果为非0值，表示像素点有笔迹，为0表示空白
        printf("*");    //笔迹像素点，输出*号
      else  
        printf(" ");    //空白像素点，输出空格
    }   

    //扫描一行内的第三个字节数据
    for(j=0;j<8;j++)  //扫描各个像素点
    {
      if(((charater[3*i+2] << j )&0x80) ) //如果运算结果为非0值，表示像素点有笔迹，为0表示空白
        printf("*");    //笔迹像素点，输出*号
      else  
        printf(" ");    //空白像素点，输出空格
    }      
    
    printf("\n");
  }
  
}


/**
  * @brief  主函数
  * @param  无
  * @retval 无
  */
int main(void)
{	
  /*初始化USART 配置模式为 115200 8-N-1，中断接收*/
  Debug_USART_Config();

  printf("test"); 

	/* 发送一个字符串 */
	Usart_SendString( DEBUG_USART,"这是一个串口中断接收回显实验\n");
	printf("这是一个串口中断接收回显实验\n");
	
  printf("\r\n\r\n");
  
  
  dis_charater();
  
  
  while(1)
	{	
		
	}	
}



/*********************************************END OF FILE**********************/

